## apps/myapps/Kconfig
```kconfig
#
# For a description of the syntax of this configuration file,
# see the file kconfig-language.txt in the NuttX tools repository.
#

menu "MyApps"

source "$APPSDIR/myapps/myled/Kconfig"
source "$APPSDIR/myapps/filesd/Kconfig"
source "$APPSDIR/myapps/gsensor/Kconfig"
source "$APPSDIR/myapps/alarm2/Kconfig"
source "$APPSDIR/myapps/console/Kconfig"
source "$APPSDIR/myapps/tempsense/Kconfig"
source "$APPSDIR/myapps/lsense/Kconfig"
source "$APPSDIR/myapps/ssend/Kconfig"

source "$APPSDIR/myapps/wap/Kconfig"
source "$APPSDIR/myapps/wap2/Kconfig"

source "$APPSDIR/myapps/test/Kconfig"
source "$APPSDIR/myapps/motor/Kconfig"
source "$APPSDIR/myapps/start/Kconfig"
source "$APPSDIR/myapps/connect/Kconfig"
source "$APPSDIR/myapps/start2/Kconfig"
source "$APPSDIR/myapps/curtain/Kconfig"
source "$APPSDIR/myapps/fan/Kconfig"
source "$APPSDIR/myapps/pump/Kconfig"



endmenu # Examples
```

## apps/myapps/alarm2/Kconfig
```kconfig
#
# For a description of the syntax of this configuration file,
# see the file kconfig-language.txt in the NuttX tools repository.
#

config MYAPPS_ALARM2
	bool "RTC alarm driver example"
	default n
	depends on RTC_DRIVER && RTC_ALARM
	---help---
		Enable the RTC driver alarm test

if MYAPPS_ALARM2

config MYAPPS_ALARM2_PROGNAME
	string "Program name"
	default "alarm"
	depends on BUILD_KERNEL
	---help---
		This is the name of the program that will be use when the NSH ELF
		program is installed.

config MYAPPS_ALARM2_PRIORITY
	int "Alarm task priority"
	default 100

config MYAPPS_ALARM2_STACKSIZE
	int "Alarm stack size"
	default 2048

config MYAPPS_ALARM2_DEVPATH
	string "RTC device path"
	default "/dev/rtc0"

config MYAPPS_ALARM2_SIGNO
	int "Alarm signal"
	default 1

endif # MYAPPS_ALARM2
```

## apps/myapps/connect/Kconfig
```kconfig
#
# For a description of the syntax of this configuration file,
# see the file kconfig-language.txt in the NuttX tools repository.
#

config MYAPPS_CONNECT
	bool "\"Connect\" app"
	default n
	---help---
		Enable the \"Connect\" app

if MYAPPS_CONNECT

config MYAPPS_CONNECT_PROGNAME
	string "Program name"
	default "connect"
	depends on BUILD_KERNEL
	---help---
		This is the name of the program that will be use when the NSH ELF
		program is installed.

config MYAPPS_CONNECT_PRIORITY
	int "connect task priority"
	default 100

config MYAPPS_CONNECT_STACKSIZE
	int "connect stack size"
	default 2048

endif # MYAPPS_CONNECT
```

## apps/myapps/console/Kconfig
```kconfig
#
# For a description of the syntax of this configuration file,
# see the file kconfig-language.txt in the NuttX tools repository.
#

config MYAPPS_CONSOLE
    bool "Serial Blaster example"
    default n
    ---help---
        Enable the serial blaster example

if MYAPPS_CONSOLE

config MYAPPS_CONSOLE_STACKSIZE
	int "CPU hog stack size"
	default 2048

config MYAPPS_CONSOLE_PRIORITY
	int "CPU hog task priority"
	default 100

endif
```

## apps/myapps/curtain/Kconfig
```kconfig
#
# For a description of the syntax of this configuration file,
# see the file kconfig-language.txt in the NuttX tools repository.
#

config MYAPPS_CURTAIN
	bool "\"Curtain\" app"
	default n
	---help---
		Enable the \"Curtain\" app

if MYAPPS_CURTAIN

config MYAPPS_CURTAIN_PROGNAME
	string "Program name"
	default "curtain"
	depends on BUILD_KERNEL
	---help---
		This is the name of the program that will be use when the NSH ELF
		program is installed.

config MYAPPS_CURTAIN_PRIORITY
	int "curtain task priority"
	default 100

config MYAPPS_CURTAIN_STACKSIZE
	int "curtain stack size"
	default 2048

endif # MYAPPS_CURTAIN
```

## apps/myapps/fan/Kconfig
```kconfig
#
# For a description of the syntax of this configuration file,
# see the file kconfig-language.txt in the NuttX tools repository.
#

config MYAPPS_FAN
	bool "\"fan\" app"
	default n
	---help---
		Enable the \"fan\" app

if MYAPPS_FAN

config MYAPPS_FAN_PROGNAME
	string "Program name"
	default "fan"
	depends on BUILD_KERNEL
	---help---
		This is the name of the program that will be use when the NSH ELF
		program is installed.

config MYAPPS_FAN_PRIORITY
	int "fan task priority"
	default 100

config MYAPPS_FAN_STACKSIZE
	int "fan stack size"
	default 2048

endif # MYAPPS_FAN
```

## apps/myapps/filesd/Kconfig
```kconfig
#
# For a description of the syntax of this configuration file,
# see the file kconfig-language.txt in the NuttX tools repository.
#

config MYAPPS_FILESD
	bool "\"File sd\" example"
	default n
	---help---
		Enable the \"File sd\" example

if MYAPPS_FILESD

config MYAPPS_FILESD_PROGNAME
	string "Program name"
	default "filesd"
	depends on BUILD_KERNEL
	---help---
		This is the name of the program that will be use when the NSH ELF
		program is installed.

config MYAPPS_FILESD_PRIORITY
	int "file sd task priority"
	default 100

config MYAPPS_FILESD_STACKSIZE
	int "file sd stack size"
	default 2048

endif # MYAPPS_FILESD
```

## apps/myapps/gsensor/Kconfig
```kconfig
#
# For a description of the syntax of this configuration file,
# see the file kconfig-language.txt in the NuttX tools repository.
#

config MYAPPS_GSENSOR
	bool "ADC ground sensor example"
	default n
	depends on ADC
	---help---
		Enable the ADC example

if MYAPPS_GSENSOR

config MYAPPS_GSENSOR_PRIORITY
	int "Alarm task priority"
	default 100

config MYAPPS_GSENSOR_STACKSIZE
	int "Alarm stack size"
	default 2048

config MYAPPS_GSENSOR_DEVPATH
	string "ADC device path"
	default "/dev/gsensor"
	---help---
		The default path to the ADC device. Default: /dev/gsensor

config MYAPPS_GSENSOR_NSAMPLES
	int "Number of Sample Groups"
	default 0
	depends on !NSH_BUILTIN_APPS
	---help---
		If NSH_BUILTIN_APPS is defined, then the number of samples is provided
		on the command line and this value is ignored.  Otherwise, this number
		of samples is collected and the program terminates.  Default:  0 (samples
		are collected indefinitely).

config MYAPPS_GSENSOR_GROUPSIZE
	int "Number of Samples per Group"
	default 4
	---help---
		The number of samples to read at once. Default: 4

config MYAPPS_GSENSOR_SWTRIG
	bool "Use software trigger"
	default y
	---help---
		Some ADCs may be configured so there is no automatic or periodic
		conversion of samples.  Rather, the ADC sampling must be trigger by
		software via an ioctl command.  Select this option only if
		applicable for your ADC configuration.  In this case, the test will
		issue the software trigger ioctl before attempting to read from the
		ADC.

endif
```

## apps/myapps/lsense/Kconfig
```kconfig
#
# For a description of the syntax of this configuration file,
# see the file kconfig-language.txt in the NuttX tools repository.
#

config MYAPPS_LSENSE
	bool "\"Light sensor\" example"
	default n
	---help---
		Enable the \"Light sensor\" example

if MYAPPS_LSENSE

config MYAPPS_LSENSE_PROGNAME
	string "Program name"
	default "lsense"
	depends on BUILD_KERNEL
	---help---
		This is the name of the program that will be use when the NSH ELF
		program is installed.

config MYAPPS_LSENSE_PRIORITY
	int "lsense task priority"
	default 100

config MYAPPS_LSENSE_STACKSIZE
	int "lsense stack size"
	default 2048

endif # MYAPPS_LSENSE
```

## apps/myapps/motor/Kconfig
```kconfig
#
# For a description of the syntax of this configuration file,
# see the file kconfig-language.txt in the NuttX tools repository.
#

config MYAPPS_MOTOR
	bool "\"Motor driver\" example"
	default n
	---help---
		Enable the \"Motor driver\" example

if MYAPPS_MOTOR

config MYAPPS_MOTOR_PROGNAME
	string "Program name"
	default "motor"
	depends on BUILD_KERNEL
	---help---
		This is the name of the program that will be use when the NSH ELF
		program is installed.

config MYAPPS_MOTOR_PRIORITY
	int "motor task priority"
	default 100

config MYAPPS_MOTOR_STACKSIZE
	int "motor stack size"
	default 2048

endif # MYAPPS_MOTOR
```

## apps/myapps/myled/Kconfig
```kconfig
#
# For a description of the syntax of this configuration file,
# see the file kconfig-language.txt in the NuttX tools repository.
#

config MYAPPS_MYLED
	bool "\"My led\" example"
	default n
	---help---
		Enable the \"My led\" example

if MYAPPS_MYLED

config MYAPPS_MYLED_PROGNAME
	string "Program name"
	default "myled"
	depends on BUILD_KERNEL
	---help---
		This is the name of the program that will be use when the NSH ELF
		program is installed.

config MYAPPS_MYLED_PRIORITY
	int "Myled task priority"
	default 100

config MYAPPS_MYLED_STACKSIZE
	int "Myled stack size"
	default 2048

config MYAPPS_MYLED_DEVPATH
	string "LED device path"
	default "/dev/myled"

config MYAPPS_MYLED_LEDSET
	hex "Subset of LEDs to use"
	default 0x0f

endif # MYAPPS_MYLED
```

## apps/myapps/pump/Kconfig
```kconfig
#
# For a description of the syntax of this configuration file,
# see the file kconfig-language.txt in the NuttX tools repository.
#

config MYAPPS_PUMP
	bool "\"Pump \" app"
	default n
	---help---
		Enable the \"Pump \" app

if MYAPPS_PUMP

config MYAPPS_PUMP_PROGNAME
	string "Program name"
	default "pump"
	depends on BUILD_KERNEL
	---help---
		This is the name of the program that will be use when the NSH ELF
		program is installed.

config MYAPPS_PUMP_PRIORITY
	int "pump task priority"
	default 100

config MYAPPS_PUMP_STACKSIZE
	int "pump stack size"
	default 2048

endif # MYAPPS_PUMP
```

## apps/myapps/ssend/Kconfig
```kconfig
#
# For a description of the syntax of this configuration file,
# see the file kconfig-language.txt in the NuttX tools repository.
#

config MYAPPS_SSEND
	bool "\"Sensor send to dweet.io\" example"
	default n
	---help---
		Enable the \"Sensor send to dweet.io\" example

if MYAPPS_SSEND

config MYAPPS_SSEND_PROGNAME
	string "Program name"
	default "ssend"
	depends on BUILD_KERNEL
	---help---
		This is the name of the program that will be use when the NSH ELF
		program is installed.

config MYAPPS_SSEND_PRIORITY
	int "ssend task priority"
	default 100

config MYAPPS_SSEND_STACKSIZE
	int "ssend stack size"
	default 2048

endif # MYAPPS_SSEND
```

## apps/myapps/start/Kconfig
```kconfig
#
# For a description of the syntax of this configuration file,
# see the file kconfig-language.txt in the NuttX tools repository.
#

config MYAPPS_START
	bool "\"Start application : Entry point for IoT application\""
	default n
	---help---
		Enable the \"Start\" application

if MYAPPS_START

config MYAPPS_START_PROGNAME
	string "Program name"
	default "start"
	depends on BUILD_KERNEL
	---help---
		This is the name of the program that will be use when the NSH ELF
		program is installed.

config MYAPPS_START_PRIORITY
	int "start task priority"
	default 100

config MYAPPS_START_STACKSIZE
	int "start stack size"
	default 16384

endif # MYAPPS_START
```

## apps/myapps/start2/Kconfig
```kconfig
#
# For a description of the syntax of this configuration file,
# see the file kconfig-language.txt in the NuttX tools repository.
#

config MYAPPS_START2
	bool "\"Offline activity\""
	default n
	---help---
		Enable the \"Start2\" application

if MYAPPS_START2

config MYAPPS_START2_PROGNAME
	string "Program name"
	default "start2"
	depends on BUILD_KERNEL
	---help---
		This is the name of the program that will be use when the NSH ELF
		program is installed.

config MYAPPS_START2_PRIORITY
	int "start2 task priority"
	default 100

config MYAPPS_START2_STACKSIZE
	int "start2 stack size"
	default 16384

endif # MYAPPS_START2
```

## apps/myapps/tempsense/Kconfig
```kconfig
#
# For a description of the syntax of this configuration file,
# see the file kconfig-language.txt in the NuttX tools repository.
#

config MYAPPS_TEMPSENSE
	bool "\"Temp sensor\" example"
	default n
	---help---
		Enable the \"Temp sensor\" example

if MYAPPS_TEMPSENSE

config MYAPPS_TEMPSENSE_PROGNAME
	string "Program name"
	default "tempsense"
	depends on BUILD_KERNEL
	---help---
		This is the name of the program that will be use when the NSH ELF
		program is installed.

config MYAPPS_TEMPSENSE_PRIORITY
	int "tempsense task priority"
	default 100

config MYAPPS_TEMPSENSE_STACKSIZE
	int "tempsense stack size"
	default 2048

endif # MYAPPS_TEMPSENSE
```

## apps/myapps/test/Kconfig
```kconfig
#
# For a description of the syntax of this configuration file,
# see the file kconfig-language.txt in the NuttX tools repository.
#

config MYAPPS_TEST
	bool "\"Tester\" example"
	default n
	---help---
		Enable the \"Tester\" example

if MYAPPS_TEST

config MYAPPS_TEST_PROGNAME
	string "Program name"
	default "test"
	depends on BUILD_KERNEL
	---help---
		This is the name of the program that will be use when the NSH ELF
		program is installed.

config MYAPPS_TEST_PRIORITY
	int "test task priority"
	default 100

config MYAPPS_TEST_STACKSIZE
	int "test stack size"
	default 2048

endif # MYAPPS_TEST
```

## apps/myapps/wap/Kconfig
```kconfig
#
# For a description of the syntax of this configuration file,
# see the file kconfig-language.txt in the NuttX tools repository.
#

config MYAPPS_WAP
	bool "\"Connect ESP8266 to WAP\" app"
	default n
	---help---
		Enable the \"Connect ESP8266 to WAP\" app

if MYAPPS_WAP

config MYAPPS_WAP_PROGNAME
	string "Program name"
	default "wap"
	depends on BUILD_KERNEL
	---help---
		This is the name of the program that will be use when the NSH ELF
		program is installed.

config MYAPPS_WAP_PRIORITY
	int "wap task priority"
	default 100

config MYAPPS_WAP_STACKSIZE
	int "wpa stack size"
	default 2048

endif # MYAPPS_WAP
```

## apps/myapps/wap2/Kconfig
```kconfig
#
# For a description of the syntax of this configuration file,
# see the file kconfig-language.txt in the NuttX tools repository.
#

config MYAPPS_WAP2
	bool "\"Connect ESP8266 to public WAP\" app"
	default n
	---help---
		Enable the \"Connect ESP8266 to public WAP\" app

if MYAPPS_WAP2

config MYAPPS_WAP2_PROGNAME
	string "Program name"
	default "wap2"
	depends on BUILD_KERNEL
	---help---
		This is the name of the program that will be use when the NSH ELF
		program is installed.

config MYAPPS_WAP2_PRIORITY
	int "wap2 task priority"
	default 100

config MYAPPS_WAP2_STACKSIZE
	int "wap2 stack size"
	default 2048

endif # MYAPPS_WAP2
```

## nuttx/drivers/motor/Kconfig
```kconfig
#
# For a description of the syntax of this configuration file,
# see the file kconfig-language.txt in the NuttX tools repository.
#

config TB6612
	bool "Enable TB6612 driver support"
	default n
	---help---
		Enable TB6612 motor controller driver. Default is no
```
